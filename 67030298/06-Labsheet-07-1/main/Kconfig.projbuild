## 67030298/06-Labsheet-07-1/main/Kconfig.projbuild
```kconfig
menu "Example Configuration"
    config EXAMPLE_RESET_PROVISIONED
        bool "Reset Provisioned state (Erase credentials)"
        default n
        help
            If this option is enabled, the device will erase the provisioned credentials on every boot.
endmenu
```

## Example_codes/Lab7-1-Reset-and-NVS-Forensics/main/Kconfig.projbuild
```kconfig
menu "Example Configuration"

    config EXAMPLE_RESET_PROVISIONED
        bool "Reset Provisioned state (Erase credentials)"
        default n
        help
            Erase the Wi-Fi credentials stored in NVS on every boot.

endmenu
```

## Lab-Week7-67030180/67030180/Lab7-1-Reset-and-NVS-Forensics/main/Kconfig.projbuild
```kconfig
menu "Example Configuration"

    config EXAMPLE_RESET_PROVISIONED
        bool "Reset Provisioned state (Erase credentials)"
        default n
        help
            If set, the device will erase all provisioning credentials from NVS
            on every boot, forcing it to enter provisioning mode.

endmenu
```
